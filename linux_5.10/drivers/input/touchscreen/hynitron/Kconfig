## linux_5.10/drivers/input/touchscreen/hynitron/Kconfig
```kconfig
config CONFIG_TOUCHSCREEN_HYNITRON_TS
	bool "hynitorn Ts for TOUCHSCREEN"
	depends on I2C
	depends on INPUT
	default y
	help
	  Say Y here if you have hynitorn touch panel.
	  If unsure, say N.
      
    
```

## linux_5.10/drivers/net/wireless/aic8800/Kconfig
```kconfig
# SPDX-License-Identifier: GPL-2.0-only
config AIC_WLAN_SUPPORT
        bool "AIC wireless Support"
        default n
        help
          This is support for aic wireless chip.
```

## osdrv/extdrv/wireless/rtl8733bs/Kconfig
```kconfig
config RTL8733BS
	depends on MMC
	tristate "Realtek 8733B SDIO WiFi"
	help
	  Realtek RTL8733BS chipset driver
	  802.11ac SDIO wireless network adapter
```

## osdrv/interdrv/v2/pwm/Kconfig
```kconfig
menuconfig PWM
	bool "Pulse-Width Modulation (PWM) Support"
	help
	  Generic Pulse-Width Modulation (PWM) support.

	  In Pulse-Width Modulation, a variation of the width of pulses
	  in a rectangular pulse signal is used as a means to alter the
	  average power of the signal. Applications include efficient
	  power delivery and voltage regulation. In computer systems,
	  PWMs are commonly used to control fans or the brightness of
	  display backlights.

	  This framework provides a generic interface to PWM devices
	  within the Linux kernel. On the driver side it provides an API
	  to register and unregister a PWM chip, an abstraction of a PWM
	  controller, that supports one or more PWM devices. Client
	  drivers can request PWM devices and use the generic framework
	  to configure as well as enable and disable them.

	  This generic framework replaces the legacy PWM framework which
	  allows only a single driver implementing the required API. Not
	  all legacy implementations have been ported to the framework
	  yet. The framework provides an API that is backward compatible
	  with the legacy framework so that existing client drivers
	  continue to work as expected.

	  If unsure, say no.

if PWM

config PWM_SYSFS
	bool
	default y if SYSFS

config PWM_CVITEK
	tristate "Cvitek PWM support"
	depends on ARCH_CVITEK
	help
	  Generic PWM framework driver for Cvitek SoCs.
	  We use it to control fan.

	  To compile this driver as a module, choose M here: the module
	  will be called cvi-pwm.

endif
```

## ramdisk/rootfs/public/Kconfig
```kconfig
source "../ramdisk/rootfs/public/adbd/Kconfig"
source "../ramdisk/rootfs/public/aic8800-fw/Kconfig"
source "../ramdisk/rootfs/public/ap6201bm/Kconfig"
source "../ramdisk/rootfs/public/binutils/Kconfig"
source "../ramdisk/rootfs/public/bluetooth/Kconfig"
source "../ramdisk/rootfs/public/busybox-full/Kconfig"
source "../ramdisk/rootfs/public/cvitracer/Kconfig"
source "../ramdisk/rootfs/public/dropbear/Kconfig"
source "../ramdisk/rootfs/public/ek/Kconfig"
source "../ramdisk/rootfs/public/empty/Kconfig"
source "../ramdisk/rootfs/public/evtest/Kconfig"
source "../ramdisk/rootfs/public/gdbserver/Kconfig"
source "../ramdisk/rootfs/public/libbtrace/Kconfig"
source "../ramdisk/rootfs/public/libcrypto/Kconfig"
source "../ramdisk/rootfs/public/libcurl/Kconfig"
source "../ramdisk/rootfs/public/libevent/Kconfig"
source "../ramdisk/rootfs/public/libiperf/Kconfig"
source "../ramdisk/rootfs/public/libiw/Kconfig"
source "../ramdisk/rootfs/public/libprotobuf/Kconfig"
source "../ramdisk/rootfs/public/libz/Kconfig"
source "../ramdisk/rootfs/public/haveged/Kconfig"
source "../ramdisk/rootfs/public/mdnsd/Kconfig"
source "../ramdisk/rootfs/public/memtester/Kconfig"
source "../ramdisk/rootfs/public/mtd-utils/Kconfig"
source "../ramdisk/rootfs/public/nanomsg/Kconfig"
source "../ramdisk/rootfs/public/openssl/Kconfig"
source "../ramdisk/rootfs/public/openssh/Kconfig"
source "../ramdisk/rootfs/public/otaserver/Kconfig"
source "../ramdisk/rootfs/public/parted/Kconfig"
source "../ramdisk/rootfs/public/pax-utils/Kconfig"
source "../ramdisk/rootfs/public/procrank/Kconfig"
source "../ramdisk/rootfs/public/procps/Kconfig"
source "../ramdisk/rootfs/public/python3.7/Kconfig"
source "../ramdisk/rootfs/public/rsyslog/Kconfig"
source "../ramdisk/rootfs/public/secure_image/Kconfig"
source "../ramdisk/rootfs/public/sftp-server/Kconfig"
source "../ramdisk/rootfs/public/tcl/Kconfig"
source "../ramdisk/rootfs/public/tcpdump/Kconfig"
source "../ramdisk/rootfs/public/wifi/Kconfig"
source "../ramdisk/rootfs/public/busybox-syslogd/Kconfig"
source "../ramdisk/rootfs/public/mt7603u/Kconfig"
source "../ramdisk/rootfs/public/libtirpc/Kconfig"
source "../ramdisk/rootfs/public/libnfs/Kconfig"
source "../ramdisk/rootfs/public/bash/Kconfig"
source "../ramdisk/rootfs/public/crontabs/Kconfig"
source "../ramdisk/rootfs/public/iperf3-3.1.7/Kconfig"
source "../ramdisk/rootfs/public/e2fsprogs/Kconfig"
source "../ramdisk/rootfs/public/gatord/Kconfig"
source "../ramdisk/rootfs/public/stress-ng/Kconfig"
source "../ramdisk/rootfs/public/strace/Kconfig"
source "../ramdisk/rootfs/public/htop/Kconfig"
source "../ramdisk/rootfs/public/ntp/Kconfig"
source "../ramdisk/rootfs/public/i2c_tool/Kconfig"
source "../ramdisk/rootfs/public/pinmux/Kconfig"
source "../ramdisk/rootfs/public/envtools/Kconfig"
source "../ramdisk/rootfs/public/haasui/Kconfig"
source "../ramdisk/rootfs/public/vmtouch/Kconfig"
source "../ramdisk/rootfs/public/cache-calibrator/Kconfig"
source "../ramdisk/rootfs/public/lz4/Kconfig"
source "../ramdisk/rootfs/public/erofs-utils/Kconfig"
source "../ramdisk/rootfs/public/links/Kconfig"
source "../ramdisk/rootfs/public/lynx/Kconfig"
source "../ramdisk/rootfs/public/mpg123/Kconfig"
source "../ramdisk/rootfs/public/mmc-utils/Kconfig"
source "../ramdisk/rootfs/public/p7zip/Kconfig"
source "../ramdisk/rootfs/public/ramspeed/Kconfig"
source "../ramdisk/rootfs/public/udpcast/Kconfig"
source "../ramdisk/rootfs/public/unrar/Kconfig"
```

## ramdisk/rootfs/public/aic8800-fw/Kconfig
```kconfig
config TARGET_PACKAGE_AIC8800_FW
	bool "Target aic8800-fw"
	default n
	help
	  target aic8800-fw
```

## ramdisk/rootfs/public/binutils/Kconfig
```kconfig
config TARGET_PACKAGE_BINUTILS
	bool "Target binutils"
	default n
	help
	  target binutils
```

## ramdisk/rootfs/public/busybox-full/Kconfig
```kconfig
config TARGET_PACKAGE_BUSYBOX_FULL
	bool "Target busybox-full"
	default n
	help
	  target busybox-full
```

## ramdisk/rootfs/public/cache-calibrator/Kconfig
```kconfig
config TARGET_PACKAGE_CACHE_CALIBRATOR
	bool "Target cache-calibrator"
	default n
	help
	  target cache-calibrator
```

## ramdisk/rootfs/public/empty/Kconfig
```kconfig
config TARGET_PACKAGE_EMPTY
	bool "Target empty"
	default n
	help
	  target empty
```

## ramdisk/rootfs/public/erofs-utils/Kconfig
```kconfig
config TARGET_PACKAGE_EROFS_UTILS
	bool "Target erofs-utils"
	default n
	help
	  target erofs-utils
```

## ramdisk/rootfs/public/evtest/Kconfig
```kconfig
config TARGET_PACKAGE_EVTEST
	bool "Target evtest"
	default n
	help
	  target evtest
```

## ramdisk/rootfs/public/haveged/Kconfig
```kconfig
config TARGET_PACKAGE_HAVEGED
	bool "Target haveged"
	default n
	help
	  target haveged
```

## ramdisk/rootfs/public/links/Kconfig
```kconfig
config TARGET_PACKAGE_LINKS
	bool "Target links"
	default n
	help
	  target links
```

## ramdisk/rootfs/public/mdnsd/Kconfig
```kconfig
config TARGET_PACKAGE_MDNSD
	bool "Target mdnsd"
	default n
	help
	  target mdnsd
```

## ramdisk/rootfs/public/memtester/Kconfig
```kconfig
config TARGET_PACKAGE_MEMTESTER
	bool "Target memtester"
	default n
	help
	  target memtester
```

## ramdisk/rootfs/public/mmc-utils/Kconfig
```kconfig
config TARGET_PACKAGE_MMC_UTILS
	bool "Target mmc-utils"
	default n
	help
	  target mmc-utils
```

## ramdisk/rootfs/public/mpg123/Kconfig
```kconfig
config TARGET_PACKAGE_MPG123
	bool "Target mpg123"
	default n
	help
	  target mpg123
```

## ramdisk/rootfs/public/openssh/Kconfig
```kconfig
config TARGET_PACKAGE_OPENSSH
	bool "Target openssh"
	default n
	help
	  target openssh
```

## ramdisk/rootfs/public/p7zip/Kconfig
```kconfig
config TARGET_PACKAGE_P7ZIP
	bool "Target p7zip"
	default n
	help
	  target p7zip
```

## ramdisk/rootfs/public/pax-utils/Kconfig
```kconfig
config TARGET_PACKAGE_PAX_UTILS
	bool "Target pax-utils"
	default n
	help
	  target pax-utils
```
