## ramdisk/rootfs/public/ramspeed/Kconfig
```kconfig
config TARGET_PACKAGE_RAMSPEED
	bool "Target ramspeed"
	default n
	help
	  target ramspeed
```

## ramdisk/rootfs/public/rndis/Kconfig
```kconfig
config TARGET_PACKAGE_RNDIS_SCRIPT
        bool "Target package rndis script"
	default n
        help
          target package rndis script
```

## ramdisk/rootfs/public/sftp-server/Kconfig
```kconfig
config TARGET_PACKAGE_SFTP_SERVER
	bool "Target sftp-server"
	default n
	help
	  target sftp-server
```

## ramdisk/rootfs/public/strace/Kconfig
```kconfig
config TARGET_PACKAGE_STRACE
	bool "Target strace"
	default n
	help
	  target strace
```

## ramdisk/rootfs/public/tcpdump/Kconfig
```kconfig
config TARGET_PACKAGE_TCPDUMP
	bool "Target tcpdump"
	default n
	help
	  target tcpdump
```

## ramdisk/rootfs/public/udpcast/Kconfig
```kconfig
config TARGET_PACKAGE_UDPCAST
	bool "Target udpcast"
	default n
	help
	  target udpcast
```

## ramdisk/rootfs/public/unrar/Kconfig
```kconfig
config TARGET_PACKAGE_UNRAR
	bool "Target unrar"
	default n
	help
	  target unrar
```

## ramdisk/rootfs/public/vmtouch/Kconfig
```kconfig
config TARGET_PACKAGE_VMTOUCH
	bool "Target vmtouch"
	default n
	help
	  target vmtouch
```

## ramdisk/rootfs/public/wireless-tools/Kconfig
```kconfig
config TARGET_PACKAGE_WIRELESS_TOOLS
	bool "Target wireless-tools"
	default n
	help
	  target wireless-tools
```

## u-boot-2021.10/board/cvitek/Kconfig
```kconfig
if TARGET_CVITEK_ARM || TARGET_CVITEK_RISCV

config TARGET_CVITEK
	def_bool n
	select ARM64 if TARGET_CVITEK_ARM
	select GENERIC_RISCV if TARGET_CVITEK_RISCV
	select ENABLE_ARM_SOC_BOOT0_HOOK if TARGET_CVITEK_ARM

choice
	prompt "Cvitek target"

config TARGET_CVITEK_CV181X
	bool "Support CVITEK CV181X"
	select TARGET_CVITEK

config TARGET_CVITEK_CV180X
	bool "Support CVITEK CV180X"
	select TARGET_CVITEK

endchoice

source "board/cvitek/mars/Kconfig"
source "board/cvitek/phobos/Kconfig"

endif
```
